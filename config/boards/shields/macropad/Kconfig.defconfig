## config/boards/shields/macropad/Kconfig.defconfig
```kconfig
if SHIELD_MACROPAD

config ZMK_KEYBOARD_NAME
    default "Stavropad"

endif # SHIELD_MACROPAD
```

## config/boards/shields/stavropad/Kconfig.defconfig
```kconfig
if SHIELD_STAVROPAD

config ZMK_KEYBOARD_NAME
    default "Stavropad"

endif # SHIELD_STAVROPAD
```
