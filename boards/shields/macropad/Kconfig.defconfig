## boards/shields/macropad/Kconfig.defconfig
```kconfig
if SHIELD_MACROPAD

config ZMK_KEYBOARD_NAME
    default "macropad"

endif # SHIELD_MACROPAD
```

## zmk-modules/batt_type/dts/bindings/behaviors/zmk,behavior-batt-type.yaml
```yaml
description: Type out current battery voltage as text

compatible: "zmk,behavior-batt-type"

include: zero_param.yaml
```
